## drivers/net/wireless/rtl8192EU/Kconfig
```kconfig
config RTL8192EU_SDK
	tristate "Realtek 8192E USB WiFi"
	depends on USB
	---help---
	  Help message of RTL8192EU
```

## drivers/net/wireless/rtl8192cu/Kconfig
```kconfig
config RTL8192CU_SDK
	tristate "Realtek 8192C USB WiFi(WEXT) - SDK Version"
	depends on USB
	---help---
	  Help message of RTL8192CU
```

## drivers/net/wireless/rtl8723AU/Kconfig
```kconfig
config RTL8723AU_SDK
	tristate "Realtek 8723A USB WiFi"
	---help---
	  Help message of RTL8723AS-VAU
```

## drivers/net/wireless/rtl8811AU/Kconfig
```kconfig
config RTL8821AU_SDK
	tristate "Realtek 8821A USB WiFi"
	depends on USB
	---help---
	  Help message of RTL8821AU
```

## drivers/net/wireless/rtl8812AU/Kconfig
```kconfig
config RTL8812AU_SDK
	tristate "Realtek 8812A USB WiFi"
	depends on USB
	---help---
	  Help message of RTL8812AU
```

## drivers/net/wireless/rtl88x2BU/Kconfig
```kconfig
config RTL8822BU_SDK
	tristate "Realtek 8822B USB WiFi"
	depends on USB
	---help---
	  Help message of RTL8822BU
```

## drivers/net/wireless/rtl8xxx_DU/Kconfig
```kconfig
config RTL8192DU_SDK
	tristate "Realtek 8192D USB WiFi"
	depends on USB
	---help---
	  Help message of RTL8192DU
```

## drivers/net/wireless/rtl8xxx_EU/Kconfig
```kconfig
config RTL8188EU_SDK
	tristate "Realtek 8188E USB WiFi"
	depends on USB
	---help---
	  Help message of RTL8188EU
```
